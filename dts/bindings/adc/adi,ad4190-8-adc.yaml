## dts/bindings/adc/adi,ad4190-8-adc.yaml
```yaml
# Copyright (c) 2026 Analog Devices, Inc.
# SPDX-License-Identifier: Apache-2.0

description: |
  Bindings for the ADI AD4190-8 ADC.

compatible: "adi,ad4190-8-adc"

include: adi,ad4170-adc.yaml
```
